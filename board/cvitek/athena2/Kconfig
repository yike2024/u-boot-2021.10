## board/cvitek/athena2/Kconfig
```kconfig
if TARGET_CVITEK_ATHENA2

choice
	prompt "Cvitek ATHENA2 verification platform type select"

config TARGET_CVITEK_ATHENA2_ASIC
	bool "ASIC"
	help
	  This enables support for Cvitek's ATHENA2 SoC on ASIC platform.

	  If unsure, say N.

config TARGET_CVITEK_ATHENA2_PALLADIUM
	bool "Palladium"
	help
	  This enables support for Cvitek's ATHENA2 SoC on PALLADIUM platform.

	  If unsure, say N.

config TARGET_CVITEK_ATHENA2_FPGA
	bool "FPGA"
	help
	  This enables support for Cvitek's ATHENA2 SoC on FPGA platform.

	  If unsure, say N.

endchoice

config SYS_BOARD
	default "athena2"

config SYS_VENDOR
	default "cvitek"

config SYS_CPU
	default "generic"

config ROOTFS_UBUNTU
	bool "Enable ubuntu file system"
	default n
	help
	  Enable ubuntu file system.

config SYS_CONFIG_NAME
	default "athena2-asic" if TARGET_CVITEK_ATHENA2_ASIC
	default "athena2-palladium" if TARGET_CVITEK_ATHENA2_PALLADIUM
	default "athena2-fpga" if TARGET_CVITEK_ATHENA2_FPGA

config CVITEK_SPI_FLASH
    bool
	prompt "Support CVITEK SPINOR"
    select SPI_FLASH
	select DM
	select DM_SPI
	select DM_SPI_FLASH
	select SPI_MEM
	select CMD_SF
    select CVI_SPIF

config ENV_SIZE
    default 0x10000 if ENV_IS_IN_SPI_FLASH
    default 0x20000 if ENV_IS_IN_MMC
	default 0x20000 if ENV_IS_IN_NAND

config ENV_SECT_SIZE
	default 0x10000 if ENV_IS_IN_SPI_FLASH
	default 0x40000 if ENV_IS_IN_MMC
	default 0x20000 if ENV_IS_IN_NAND

config ENV_OFFSET
    default 0x3A0000 if ENV_IS_IN_SPI_FLASH
    default 0x880000 if ENV_IS_IN_MMC
	default 0xae0000 if ENV_IS_IN_NAND

config ENV_OFFSET_REDUND
    default 0x3B0000 if ENV_IS_IN_SPI_FLASH
	default 0xb00000 if ENV_IS_IN_NAND

endif
```

## drivers/crypto/Kconfig
```kconfig
menu "Hardware crypto devices"

source drivers/crypto/fsl/Kconfig

config SOPHON_SPACC_SHA
        bool "sophon spacc sha"
        help
          Select Crypto driver for sophon platfrom

endmenu
```
